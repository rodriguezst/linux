## Documentation/devicetree/bindings/media/qcom,sm8150-venus.yaml
```yaml
# SPDX-License-Identifier: (GPL-2.0 OR BSD-2-Clause)
%YAML 1.2
---
$id: http://devicetree.org/schemas/media/qcom,sm8150-venus.yaml#
$schema: http://devicetree.org/meta-schemas/core.yaml#

title: Qualcomm SM8150 Venus video encode and decode accelerators

maintainers:
  - Stanimir Varbanov <stanimir.varbanov@linaro.org>

description: |
  The Venus IP is a video encode and decode accelerator present
  on Qualcomm platforms

allOf:
  - $ref: qcom,venus-common.yaml#

properties:
  compatible:
    const: qcom,sm8150-venus

  power-domains:
    minItems: 3
    maxItems: 4

  power-domain-names:
    minItems: 3
    items:
      - const: venus
      - const: vcodec0
      - const: vcodec1
      - const: mx

  clocks:
    maxItems: 4

  clock-names:
    items:
      - const: iface
      - const: core
      - const: vcodec0_core
      - const: vcodec1_core

  iommus:
    maxItems: 2

  interconnects:
    maxItems: 2

  interconnect-names:
    items:
      - const: cpu-cfg
      - const: video-mem

required:
  - compatible
  - power-domain-names

unevaluatedProperties: false

examples:
  - |
        #include <dt-bindings/interrupt-controller/arm-gic.h>
        #include <dt-bindings/clock/qcom,videocc-sm8150.h>
        #include <dt-bindings/clock/qcom,gcc-sm8150.h>
        #include <dt-bindings/power/qcom,rpmpd.h>

        venus: video-codec@aa00000 {
            compatible = "qcom,sm8150-venus";
            reg = <0 0x0aa00000 0 0x100000>;
            interrupts = <GIC_SPI 174 IRQ_TYPE_LEVEL_HIGH>;
            power-domains = <&videocc VENUS_GDSC>,
                            <&videocc VCODEC0_GDSC>,
                            <&videocc VCODEC1_GDSC>,
                            <&rpmhpd SM8150_MX>;
            power-domain-names = "venus", "vcodec0", "vcodec1", "mx";

            clocks = <&gcc GCC_VIDEO_AXI0_CLK>,
                     <&videocc VIDEO_CC_MVSC_CORE_CLK>,
                     <&videocc VIDEO_CC_MVS0_CORE_CLK>,
                     <&videocc VIDEO_CC_MVS1_CORE_CLK>;
            clock-names = "iface", "core", "vcodec0_core", "vcodec1_core";

            interconnects = <&gem_noc MASTER_AMPSS_M0 0 &config_noc SLAVE_VENUS_CFG 0>,
                            <&mmss_noc MASTER_VIDEO_P0 0 &mc_virt SLAVE_EBI_CH0 0>;
            interconnect-names = "cpu-cfg", "video-mem";

            iommus = <&apps_smmu 0x10A0 0x8>,
                     <&apps_smmu 0x10B0 0x0>;
            memory-region = <&venus_mem>;

            video-decoder {
                compatible = "venus-decoder";
            };

            video-encoder {
                compatible = "venus-encoder";
            };
        };

...
```
